## conf/layer.conf
```bitbake
# We have a conf and classes directory, add to BBPATH
BBPATH .= ":${LAYERDIR}"

# We have recipes-* directories, add to BBFILES
BBFILES += "${LAYERDIR}/recipes-*/*/*.bb \
	${LAYERDIR}/recipes-*/*/*.bbappend"

BBFILE_COLLECTIONS += "aos"
BBFILE_PATTERN_aos = "^${LAYERDIR}/"
BBFILE_PRIORITY_aos = "10"

LAYERSERIES_COMPAT_aos = "dunfell kirkstone scarthgap"
LAYERDEPENDS_aos = "virtualization-layer"

# Aos configuration

AOS_UNIT_MODEL ?= "aos-unit"
AOS_UNIT_VERSION ?= "1.0"

AOS_MAIN_NODE ?= "1"

AOS_NODE_TYPE ?= "${AOS_UNIT_MODEL}-${AOS_UNIT_VERSION}-${@'main' \
	if bb.utils.to_boolean(d.getVar('AOS_MAIN_NODE')) else 'secondary'} \
"

AOS_RUNNER ??= "crun"

AOS_NODE_HOSTNAME ?= "${@'main' if bb.utils.to_boolean(d.getVar('AOS_MAIN_NODE')) else 'secondary'}"
AOS_MAIN_NODE_HOSTNAME ?= "main"

AOS_UM_COMPONENT_PREFIX ?= ""

# Overrides

OVERRIDES:append = "${@':aos-main-node' if bb.utils.to_boolean(d.getVar('AOS_MAIN_NODE')) else ':aos-secondary-node'}"

# Aos dirs

aos_var_dir = "${localstatedir}/aos"
aos_opt_dir = "${base_prefix}/opt/aos"

# Go version

GOVERSION = "1.20%"
PREFERRED_PROVIDER_go-native = "go-binary-native"

# Configure log dir to be stored in persistent storage
VOLATILE_LOG_DIR:aos-update = "no"
```
